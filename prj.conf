## prj.conf
```kconfig
# --- Section A)Disable unused peripherals ---

CONFIG_SPI=n
CONFIG_PRINTK=y
CONFIG_STDOUT_CONSOLE=y
CONFIG_LOG=y
CONFIG_LOG_PRINTK=y
# --- Section A End ---
# --- Section B)Enable specific hardware ---
# STEP 4.2 - Enable floating point format specifiers
CONFIG_CBPRINTF_FP_SUPPORT=y
# CONFIG_HEAP_MEM_POOL_SIZE=16384
CONFIG_DEBUG_OPTIMIZATIONS=y    
# https://developer.nordicsemi.com/nRF_Connect_SDK/doc/latest/zephyr/develop/optimizations/footprint.html
# CONFIG_ISR_STACK_SIZE=2048
CONFIG_MAIN_STACK_SIZE=8192
# CONFIG_SYSTEM_WORKQUEUE_STACK_SIZE=1024
# CONFIG_PRIVILEGED_STACK_SIZE= 1024
CONFIG_FPU=y # Enable floating point unit hardware support
# --- Section B End ---
# Section C) Executing Time Functions
CONFIG_TIMING_FUNCTIONS=y
CONFIG_SERIAL=n # _This (1) 
 
# enable console 
CONFIG_CONSOLE=n # _This (1) 
CONFIG_UART_CONSOLE=n # _This (1)
```

## src/main.c
```c
#include <zephyr/kernel.h>
#include <zephyr/sys/printk.h>
#include <zephyr/device.h>
#include <stdio.h>
#include <stdlib.h>
#include <stdint.h>
// use this or trle.c
#define _putc(__ch, __out) *__out++ = (__ch)
#define _getc(in, in_) (in<in_?(*in++):-1)
#define _rewind(in,_in) in = _in

// Compression function
int mrlec(unsigned char *in,  int inlen, unsigned char *out) {
  unsigned char *ip = in, *in_ = in+inlen,*op = out; int i;
  int c, pc = -1;  			// current and last char
  long long t[256]={0};  	// byte -> savings
  long long run = 0;  		// current run length
							// Pass 1: determine which chars will compress
  while((c = _getc(ip, in_)) != -1) { 
    if (c == pc) t[c] += (++run%255)!=0;
    else --t[c], run=0;
    pc = c;
  }
  for (i = 0; i < 32; ++i) { int j;
    c = 0;
    for (j=0; j<8; ++j) c += (t[i*8+j]>0)<<j;
    _putc(c, op);
  }
  _rewind(ip,in);  c = pc=-1;  run=0;
  do { c = _getc(ip,in_);
    if(c == pc) ++run;
    else if (run>0 && t[pc]>0) {  _putc(pc, op); 
	  for (; run>255; run-=255){ _putc(255, op);}  _putc(run-1, op); run=1; 
	} else for (++run; run>1; --run) _putc(pc, op);
    pc = c;
  } while(c!=-1);

  return op - out;
}


int main() {
    // Define input values
    double in_values[] = {
        9.739696383476257324e-01,
        9.132320880889892578e-01,
        8.655097484588623047e-01,
        8.232104182243347168e-01,
        7.462038993835449219e-01,
        6.420824527740478516e-01,
        5.477223396301269531e-01,
        4.262472987174987793e-01,
        3.253796100616455078e-01,
        2.798264622688293457e-01,
        2.288503199815750122e-01,
        1.366594433784484863e-01,
        4.772234335541725159e-02,
        1.084598712623119354e-02,
        1.008676812052726746e-01,
        1.887201666831970215e-01,
        2.277657240629196167e-01,
        2.407809048891067505e-01,
        2.570498883724212646e-01,
        2.635574936866760254e-01
    
        
    };

    const int num_elements = sizeof(in_values) / sizeof(double);

    // Convert double values to uint32_t
    uint32_t *uint_data = (uint32_t *)malloc(num_elements * sizeof(uint32_t));
    for (int i = 0; i < num_elements; ++i) {
        uint_data[i] = (uint32_t)(in_values[i] * UINT32_MAX);
    }

    // Compress data
    unsigned char *in = (unsigned char*)uint_data;
    unsigned char *out = (unsigned char*)malloc(num_elements * sizeof(double) * 4 / 3);
    int compressed_size = mrlec(in, num_elements * sizeof(uint32_t), out);

    // Calculate compression rate
    double compression_rate = (double)compressed_size / (num_elements * sizeof(uint32_t)) * 100;

    printf("Compression Rate: %.2f%%\n", compression_rate);

    // Free allocated memory
    free(uint_data);
    free(out);

    return 0;
}
```

## src/mrle.c
```c
// Mespotine RLE compressor 
// Copyright (C) powturbo 2015-2020
// Written by Matt Mahoney. Public domain. Modified to In-Memory by powturbo
//#include "mrle.h"

#include <zephyr/kernel.h>
#include <zephyr/sys/printk.h>
#include <zephyr/device.h>
#include <stdio.h>
#include <stdlib.h>
#include <stdint.h>
#include <stdbool.h>
#include <string.h>
#define _putc(__ch, __out) *__out++ = (__ch)
#define _getc(in, in_) (in<in_?(*in++):-1)
#define _rewind(in,_in) in = _in

int mrlec(unsigned char *in,  int inlen, unsigned char *out) {
  unsigned char *ip = in, *in_ = in+inlen,*op = out; int i;
  int c, pc = -1;  			// current and last char
  long long t[256]={0};  	// byte -> savings
  long long run = 0;  		// current run length
							// Pass 1: determine which chars will compress
  while((c = _getc(ip, in_)) != -1) { 
    if (c == pc) t[c] += (++run%255)!=0;
    else --t[c], run=0;
    pc = c;
  }
  for (i = 0; i < 32; ++i) { int j;
    c = 0;
    for (j=0; j<8; ++j) c += (t[i*8+j]>0)<<j;
    _putc(c, op);
  }
  _rewind(ip,in);  c = pc=-1;  run=0;
  do { c = _getc(ip,in_);
    if(c == pc) ++run;
    else if (run>0 && t[pc]>0) {  _putc(pc, op); 
	  for (; run>255; run-=255){ _putc(255, op);}  _putc(run-1, op); run=1; 
	} else for (++run; run>1; --run) _putc(pc, op);
    pc = c;
  } while(c!=-1);

  return op - out;
}

int mrled(unsigned char *in, unsigned char *out, int outlen) {
  unsigned char *ip = in,*op = out; int i;

  int c, pc = -1;  			// current and last char
  long long t[256]={0};  	// byte -> savings
  long long run = 0;  		// current run length
  for (i = 0; i < 32; ++i) { int j;
    c = *ip++;//_getc(ip,in_);
    for (j=0; j<8; ++j)
      t[i*8+j]=(c>>j)&1;
  }
  while (op < out+outlen) { c = *ip++;//(c=_getc(ip,in_))!=-1) {
    if (t[c]) {
      for (run = 0; (pc=*ip++/*_getc(ip,in_)*/)==255; run += 255);
      run += pc+1;
      for (; run > 0; --run) _putc(c, op);
    }
    else _putc(c, op);
  }
  return ip-in;
}
```

## src/time_.h
```c
/**
    Copyright (C) powturbo 2013-2023
    GPL v2 License

    This program is free software; you can redistribute it and/or modify
    it under the terms of the GNU General Public License as published by
    the Free Software Foundation; either version 2 of the License, or
    (at your option) any later version.

    This program is distributed in the hope that it will be useful,
    but WITHOUT ANY WARRANTY; without even the implied warranty of
    MERCHANTABILITY or FITNESS FOR A PARTICULAR PURPOSE.  See the
    GNU General Public License for more details.

    You should have received a copy of the GNU General Public License along
    with this program; if not, write to the Free Software Foundation, Inc.,
    51 Franklin Street, Fifth Floor, Boston, MA 02110-1301 USA.

    - homepage : https://sites.google.com/site/powturbo/
    - github   : https://github.com/powturbo
    - twitter  : https://twitter.com/powturbo
    - email    : powturbo [_AT_] gmail [_DOT_] com
**/
//      time_.h : parameter free high precision time/benchmark functions
#include <time.h>
#include <float.h>
  #ifdef _WIN32
#include <windows.h>
    #ifndef sleep
#define sleep(n) Sleep((n) * 1000)
    #endif
#define uint64_t unsigned __int64

  #else
#include <stdint.h>
#include <unistd.h>
#include <stdio.h>
#define Sleep(ms) usleep((ms) * 1000)
  #endif

#if defined (__i386__) || defined( __x86_64__ )  // ------------------ rdtsc --------------------------
  #ifdef _MSC_VER
#include <intrin.h> // __rdtsc
  #else
#include <x86intrin.h>
  #endif

  #ifdef __corei7__
#define RDTSC_INI(_c_) do { unsigned _cl, _ch;              \
  __asm volatile ("cpuid\n\t"                               \
                "rdtsc\n\t"                                 \
                "mov %%edx, %0\n"                           \
                "mov %%eax, %1\n": "=r" (_ch), "=r" (_cl):: \
                "%rax", "%rbx", "%rcx", "%rdx");            \
  _c_ = (uint64_t)_ch << 32 | _cl;              \
} while(0)

#define RDTSC(_c_) do { unsigned _cl, _ch;                  \
  __asm volatile("rdtscp\n"                                 \
               "mov %%edx, %0\n"                            \
               "mov %%eax, %1\n"                            \
               "cpuid\n\t": "=r" (_ch), "=r" (_cl):: "%rax",\
               "%rbx", "%rcx", "%rdx");\
  _c_ = (uint64_t)_ch << 32 | _cl;\
} while(0)
  #else
/*#define RDTSC(_c_) do { unsigned _cl, _ch;\
  __asm volatile ("cpuid \n"\
                "rdtsc"\
                : "=a"(_cl), "=d"(_ch)\
                : "a"(0)\
                : "%ebx", "%ecx");\
  _c_ = (uint64_t)_ch << 32 | _cl;\
} while(0)*/
#define RDTSC(_c_) do { unsigned _cl, _ch;\
   __asm volatile("rdtsc" : "=a"(_cl), "=d"(_ch) );\
  _c_ = (uint64_t)_ch << 32 | _cl;\
} while(0)
  #endif

#define RDTSC_INI(_c_) RDTSC(_c_)
#else                                          // ------------------ time --------------------------
#define RDTSC_INI(_c_)
#define RDTSC(_c_)
#endif

#ifndef TM_F
#define TM_F 1.0  // TM_F=4 -> MI/s
#endif

#ifdef _RDTSC //---------------------- rdtsc --------------------------------
#define TM_M   (CLOCKS_PER_SEC*1000000ull)
#define TM_PRE 4
#define TM_MBS "cycle/byte"
static double TMBS(unsigned l, double t) { return (double)t/(double)l; }

typedef uint64_t tm_t;
static tm_t   tmtime()                      { uint64_t c; RDTSC(c); return c; }
static tm_t   tminit()                      { uint64_t c; __asm volatile("" ::: "memory"); RDTSC_INI(c); return c; }
static double tmdiff(tm_t start, tm_t stop) { return (double)(stop - start); }
static int    tmiszero(tm_t t)              { return !t; }
#else          //---------------------- time -----------------------------------
#define TM_M   1
#define TM_PRE 2
#define TM_MBS "MB/s"
static double TMBS(unsigned l, double t) { return (l/t)/1000000.0; }

  #ifdef _WIN32 //-------- windows 
static LARGE_INTEGER tps;

typedef unsigned __int64 tm_t;
static tm_t   tmtime()                      { LARGE_INTEGER tm; tm_t t; QueryPerformanceCounter(&tm); return tm.QuadPart; }
static tm_t   tminit()                      { tm_t t0,ts; QueryPerformanceFrequency(&tps); t0 = tmtime(); while((ts = tmtime())==t0) {}; return ts; }
static double tmdiff(tm_t start, tm_t stop) { return (double)(stop - start)/tps.QuadPart; }
static int    tmiszero(tm_t t)              { return !t; }
  #else        // Linux & compatible / MacOS
    #ifdef __APPLE__
#include <AvailabilityMacros.h>
      #ifndef MAC_OS_X_VERSION_10_12
#define MAC_OS_X_VERSION_10_12 101200
      #endif
#define CIVETWEB_APPLE_HAVE_CLOCK_GETTIME (defined(__APPLE__) && defined(MAC_OS_X_VERSION_MIN_REQUIRED) && MAC_OS_X_VERSION_MIN_REQUIRED >= MAC_OS_X_VERSION_10_12)
      #if !(CIVETWEB_APPLE_HAVE_CLOCK_GETTIME)
#include <sys/time.h>
#define CLOCK_REALTIME 0

int clock_gettime(int /*clk_id*/, struct timespec* t) {
  struct timeval now;
  int rv = gettimeofday(&now, NULL);
  if (rv) return rv;
  t->tv_sec  = now.tv_sec;
  t->tv_nsec = now.tv_usec * 1000;
  return 0;
}
      #endif
    #endif

#include <sys/time.h>
//#define CLOCK_REALTIME 0
int clock_gettime(int /*clk_id*/, struct timespec* t) {
  struct timeval now;
  int rv = gettimeofday(&now, NULL);
  if (rv) return rv;
  t->tv_sec  = now.tv_sec;
  t->tv_nsec = now.tv_usec * 1000;
  return 0;
}
#define CLOCK_MONOTONIC 0   
typedef struct timespec tm_t;   
static tm_t   tmtime()                      { struct timespec tm; clock_gettime(CLOCK_MONOTONIC, &tm); return tm; }
static double tmdiff(tm_t start, tm_t stop) { return (stop.tv_sec - start.tv_sec) + (double)(stop.tv_nsec - start.tv_nsec)/1e9f; }
static tm_t   tminit()                      { tm_t t0 = tmtime(),t; while(!tmdiff(t = tmtime(),t0)) {}; return t; }
static int    tmiszero(tm_t t)              { return !(t.tv_sec|t.tv_nsec); }
  #endif
#endif 

//---------------------------------------- bench ----------------------------------------------------------------------
// for each a function call is repeated until exceeding tm_tx seconds.
// A run duration is always tm_tx seconds
// The number of runs can be set with the program options  -I and -J (specify -I15 -J15 for more precision)

// sleep after each 8 runs to avoid cpu throttling.
#define TMSLEEP do { tm_T = tmtime(); if(tmiszero(tm_0)) tm_0 = tm_T; else if(tmdiff(tm_0, tm_T) > tm_TX) { if(tm_verbose>2) { printf("S \b\b");fflush(stdout); } sleep(tm_slp); tm_0=tmtime();} } while(0)

// benchmark loop
#define TMBEG(_tm_Reps_) { unsigned _tm_r,_tm_c = 0,_tm_R,_tm_Rx = _tm_Reps_,_tm_Rn = _tm_Reps_; double _tm_t;\
  for(tm_rm = tm_rep, tm_tm = DBL_MAX, _tm_R = 0; _tm_R < _tm_Rn; _tm_R++) { tm_t _tm_t0 = tminit(); /*for each run*/\
    for(_tm_r = 0;_tm_r < tm_rm;) { /*repeat tm_rm times */

#define TMEND(_len_) \
      _tm_r++; if(tm_tm == DBL_MAX && (_tm_t = tmdiff(_tm_t0, tmtime())) > tm_tx) break;\
    }\
    /*1st run: break the loop after tm_tx=1 sec, calculate a new repeats 'tm_rm' to avoid calling time() after each function call*/\
    /*other runs: break the loop only after 'tm_rm' repeats */ \
    _tm_t = tmdiff(_tm_t0, tmtime());\
    /*set min time, recalculate repeats tm_rm based on tm_tx, recalculate number of runs based on tm_TX*/\
    if(_tm_t < tm_tm) { if(tm_tm == DBL_MAX) { tm_rm = _tm_r; _tm_Rn = tm_TX/_tm_t; _tm_Rn = _tm_Rn<_tm_Rx?_tm_Rn:_tm_Rx; /*printf("repeats=%u,%u,%.4f ", _tm_Rn, _tm_Rx, _tm_t);*/ } \
	  tm_tm = _tm_t; _tm_c++;\
    } else if(_tm_t > tm_tm*1.15) TMSLEEP;/*force sleep at 15% divergence*/\
    if(tm_verbose>2) { printf("%8.*f %2d_%.2d\b\b\b\b\b\b\b\b\b\b\b\b\b\b",TM_PRE, TMBS(_len_, tm_tm/tm_rm),_tm_R+1,_tm_c),fflush(stdout); }\
    if((_tm_R & 7)==7) sleep(tm_slp); /*pause 20 secs after each 8 runs to avoid cpu throttling*/\
  }\
}

static unsigned tm_rep = 1u<<30, tm_Rep = 3, tm_Rep2 = 3, tm_rm, tm_RepMin = 1, tm_slp = 20, tm_verbose = 3;
static tm_t tm_0, tm_T;
static double tm_tm, tm_tx = 1.0*TM_M, tm_TX = 60.0*TM_M;

static void tm_init(int _tm_Rep, int _tm_verbose) { tm_verbose = _tm_verbose; if(_tm_Rep) tm_Rep = _tm_Rep; }

#define TMBENCH(_name_, _func_, _len_)  do { if(tm_verbose>=1) printf("%s ", _name_?_name_:#_func_);\
  TMBEG(tm_Rep) _func_; TMEND(_len_); \
  double dm = tm_tm, dr = tm_rm; \
  if(tm_verbose>2) printf("%8.*f      \b\b\b\b\b", TM_PRE, TMBS(_len_, dm/dr) );\
  else if(tm_verbose) printf("%8.*f      ", TM_PRE, TMBS(_len_, dm/dr) );\
} while(0)

// second TMBENCH. Example: use TMBENCH for encoding and TMBENCH2 for decoding
#define TMBENCH2(_name_, _func_, _len_)  do { \
  TMBEG(tm_Rep2) _func_; TMEND(_len_);\
  double dm = tm_tm, dr = tm_rm; if(tm_verbose>2) printf("%8.*f      \b\b\b\b\b", TM_PRE,TMBS(_len_, dm/dr) );else if(tm_verbose) printf("%8.*f      ", TM_PRE,TMBS(_len_, dm/dr) );\
  if(tm_verbose>=1) printf("%s ", _name_?_name_:#_func_);\
} while(0)

// Check
#define TMBENCHT(_name_,_func_, _len_, _res_)  do { \
  TMBEG(tm_Rep) \
  if(_func_ != _res_) { printf("ERROR: %lld != %lld", (long long)_func_, (long long)_res_ ); exit(0); };\
  TMEND(_len_);\
  if(tm_verbose>2) printf("%8.*f      \b\b\b\b\b", TM_PRE, TMBS(_len_,(double)tm_tm/(double)tm_rm) );\
  if(tm_verbose>1) printf("%s ", _name_?_name_:#_func_ );\
} while(0)

static void pr(unsigned l, unsigned n) {
  double r = (double)l*100.0/n;
  if(r>0.1)  printf("%10u %6.2f%%   ", l, r);
  else if(r>0.01) printf("%10u %7.3f%%  ", l, r);
  else {printf("%10u %8.4f%% ", l, r); fflush(stdout);}
}

//----------------------------------------------------------------------------------------------------------------------------------
#define Kb (1u<<10)
#define Mb (1u<<20)
#define Gb (1u<<30)
#define KB 1000
#define MB 1000000
#define GB 1000000000

static unsigned argtoi(char *s, unsigned def) {
  char *p;
  unsigned n = strtol(s, &p, 10),f = 1;
  switch(*p) {
    case 'K': f = KB; break;
    case 'M': f = MB; break;
    case 'G': f = GB; break;
    case 'k': f = Kb; break;
    case 'm': f = Mb; break;
    case 'g': f = Gb; break;
    case 'B': return n; break;
    case 'b': def = 0;
    default: if(!def) return n>=32?0xffffffffu:(1u << n); f = def;
  }
  return n*f;
}
static uint64_t argtol(char *s) {
  char *p;
  uint64_t n = strtol(s, &p, 10),f=1;
  switch(*p) {
    case 'K': f = KB; break;
    case 'M': f = MB; break;
    case 'G': f = GB; break;
    case 'k': f = Kb; break;
    case 'm': f = Mb; break;
    case 'g': f = Gb; break;
    case 'B': return n; break;
    case 'b': return 1u << n;
    default:  f = MB;
  }
  return n*f;
}

static uint64_t argtot(char *s) {
  char *p;
  uint64_t n = strtol(s, &p, 10),f=1;
  switch(*p) {
    case 'h': f = 3600000; break;
    case 'm': f = 60000;   break;
    case 's': f = 1000;    break;
    case 'M': f = 1;       break;
    default:  f = 1000;
  }
  return n*f;
}

static void memrcpy(unsigned char *out, unsigned char *in, unsigned n) { int i; for(i = 0; i < n; i++) out[i] = ~in[i]; }
```

## src/trle.c
```c
/**
    Copyright (C) powturbo 2015-2023
    SPDX-License-Identifier: GPL v2 License

    This program is free software; you can redistribute it and/or modify
    it under the terms of the GNU General Public License as published by
    the Free Software Foundation; either version 2 of the License, or
    (at your option) any later version.

    This program is distributed in the hope that it will be useful,
    but WITHOUT ANY WARRANTY; without even the implied warranty of
    MERCHANTABILITY or FITNESS FOR A PARTICULAR PURPOSE.  See the
    GNU General Public License for more details.

    You should have received a copy of the GNU General Public License along
    with this program; if not, write to the Free Software Foundation, Inc.,
    51 Franklin Street, Fifth Floor, Boston, MA 02110-1301 USA.

    - email    : powturbo [AT] gmail.com
    - github   : https://github.com/powturbo
    - homepage : https://sites.google.com/site/powturbo/
    - twitter  : https://twitter.com/powturbo

    TurboRLE - "Most efficient and fastest Run Length Encoding"
**/      
#include <zephyr/kernel.h>
#include <zephyr/sys/printk.h>
#include <zephyr/device.h>
#include <stdio.h>
#include <stdlib.h>
#include <stdint.h>
#include <stdbool.h>
#include <string.h>
#ifdef __APPLE__
#include <sys/malloc.h>
#else
#include <malloc.h>
#endif
  #ifdef _MSC_VER
#include "vs/getopt.h"
  #else
#include <getopt.h> 
#endif
#include "trle.h"
#include "time_.h"

#include "mrle.c"

#ifdef __clang__
#pragma clang diagnostic ignored "-Wdeclaration-after-statement"
#endif

#define ID_MEMCPY 8

const float data[] = {
    9.739696383476257324e-01,
    9.132320880889892578e-01,
    8.655097484588623047e-01,
    8.232104182243347168e-01,
    7.462038993835449219e-01,
    6.420824527740478516e-01
};

void libmemcpy(unsigned char *dst, unsigned char *src, int len) {
  memcpy(dst, src, len);
}

unsigned bench(unsigned char *in, unsigned n, unsigned char *out, unsigned char *cpy, int id) { 
  unsigned l = 0;
  memrcpy(cpy,in,n); 
  switch(id) {
    case 1: TMBENCH("\ntrle   ", l=trlec(  in, n, out) ,n); 						 printf("%10u %5.1f%%", l, (double)l*100.0/n); TMBENCH("",trled(  out, l, cpy, n) ,n); break;
    case 2: TMBENCH("\nsrle 0 ", l=srlec(  in, n, out) ,n); 						 printf("%10u %5.1f%%", l, (double)l*100.0/n); TMBENCH("",srled(  out, l, cpy, n) ,n); break;      
    case 3: TMBENCH("\nsrle 8 ", l=srlec8( in, n, out, 0xda) ,n); 				     printf("%10u %5.1f%%", l, (double)l*100.0/n); TMBENCH("",srled8( out, l, cpy, n, 0xda) ,n); break;      
    case 4: TMBENCH("\nsrle 16", l=srlec16(in, n, out, 0xdada) ,n); 				 printf("%10u %5.1f%%", l, (double)l*100.0/n); TMBENCH("",srled16(out, l, cpy, n, 0xdada) ,n); break;      
    case 5: TMBENCH("\nsrle 32", l=srlec32(in, n, out, 0xdadadadau) ,n); 			 printf("%10u %5.1f%%", l, (double)l*100.0/n); TMBENCH("",srled32(out, l, cpy, n, 0xdadadadau) ,n); break;      
    case 6: TMBENCH("\nsrle 64", l=srlec64(in, n, out, 0xdadadadadadadadaull) ,n); 	 printf("%10u %5.1f%%", l, (double)l*100.0/n); TMBENCH("",srled64(out, l, cpy, n, 0xdadadadadadadadaull) ,n); break;      
    case 7: TMBENCH("\nmrle   ", l=mrlec(  in, n, out), n);						 	 printf("%10u %5.1f%%", l, (double)l*100.0/n); TMBENCH("",mrled(  out, cpy, n), n); break;
    case 8: TMBENCH("\nmemcpy ", libmemcpy(in,out,n) ,n);  							 printf("%10u %5.1f%%", n, (double)100.0); return n;
	default: return l;
  }
  memcheck(in,n,cpy);
  return l;
}

int main(int argc, char* argv[]) {
  unsigned trips = 4, cmp = 1, b = 1 << 30, esize = 4, lz = 0, fno, id = 0;

  // Allocate memory for input and output
  unsigned n = sizeof(data) / sizeof(data[0]);
  float *in = (float*)malloc(n * sizeof(float));
  unsigned char *out = (unsigned char*)malloc(n * 4 / 3 + 1024);
  unsigned char *cpy = NULL;

  if (!in || !out) {
    fprintf(stderr, "Memory allocation error\n");
    exit(-1);
  }

  for (int i = 0; i < n; i++) {
    in[i] = data[i];
  }

  tm_init(trips, 1);

  if (!id) {
    printf("function  E MB/s   size      ratio   D MB/s");      
    for(int i = 1; i <= ID_MEMCPY; i++) {
      bench(in, n, out, cpy, i);
    }
  } else {
    bench(in, n, out, cpy, id);    
  }

  // Free allocated memory
  free(in);
  free(out);
  if (cpy) {
    free(cpy);
  }

  return 0;
}
```

## src/trle.h
```c
// ----- TurboRLE - "Most efficient and fastest Run Length Encoding" -----------------------------------------------------------
#if defined(_MSC_VER) && (_MSC_VER < 1600)
  #if !defined(_STDINT) && !defined(_MSC_STDINT_H_)
typedef unsigned char      uint8_t;
typedef unsigned short     uint16_t;
typedef unsigned int       uint32_t;
typedef unsigned long long uint64_t;
  #endif

#else
#include <stdint.h>
#endif

#ifdef __cplusplus
extern "C" {
#endif
// RLE with specified escape char
unsigned _srlec8( const unsigned char *__restrict in, unsigned inlen, unsigned char *__restrict out, uint8_t e);
unsigned _srled8( const unsigned char *__restrict in,                 unsigned char *__restrict out, unsigned outlen, uint8_t e);

unsigned _srlec16(const unsigned char *__restrict in, unsigned inlen, unsigned char *__restrict out, uint16_t e);
unsigned _srled16(const unsigned char *__restrict in,                 unsigned char *__restrict out, unsigned outlen, uint16_t e);

unsigned _srlec32(const unsigned char *__restrict in, unsigned inlen, unsigned char *__restrict out, uint32_t e);
unsigned _srled32(const unsigned char *__restrict in,                 unsigned char *__restrict out, unsigned outlen, uint32_t e);

unsigned _srlec64(const unsigned char *__restrict in, unsigned inlen, unsigned char *__restrict out, uint64_t e);
unsigned _srled64(const unsigned char *__restrict in,                 unsigned char *__restrict out, unsigned outlen, uint64_t e);

// functions w/ overflow handling
unsigned  srlec8( const unsigned char *__restrict in, unsigned inlen, unsigned char *__restrict out, uint8_t e);
unsigned  srled8( const unsigned char *__restrict in, unsigned inlen, unsigned char *__restrict out, unsigned outlen, uint8_t e);

unsigned  srlec16(const unsigned char *__restrict in, unsigned inlen, unsigned char *__restrict out, uint16_t e);
unsigned  srled16(const unsigned char *__restrict in, unsigned inlen, unsigned char *__restrict out, unsigned outlen, uint16_t e);

unsigned  srlec32(const unsigned char *__restrict in, unsigned inlen, unsigned char *__restrict out, uint32_t e);
unsigned  srled32(const unsigned char *__restrict in, unsigned inlen, unsigned char *__restrict out, unsigned outlen, uint32_t e);

unsigned  srlec64(const unsigned char *__restrict in, unsigned inlen, unsigned char *__restrict out, uint64_t e);
unsigned  srled64(const unsigned char *__restrict in, unsigned inlen, unsigned char *__restrict out, unsigned outlen, uint64_t e);

// RLE w. automatic escape char determination
unsigned  srlec(  const unsigned char *__restrict in, unsigned inlen, unsigned char *__restrict out);
unsigned _srled(  const unsigned char *__restrict in,                 unsigned char *__restrict out, unsigned outlen);
unsigned  srled(  const unsigned char *__restrict in, unsigned inlen, unsigned char *__restrict out, unsigned outlen);

// Turbo RLE
unsigned  trlec(  const unsigned char *__restrict in, unsigned inlen, unsigned char *__restrict out);
unsigned _trled(  const unsigned char *__restrict in,                 unsigned char *__restrict out, unsigned outlen);
unsigned  trled(  const unsigned char *__restrict in, unsigned inlen, unsigned char *__restrict out, unsigned outlen);
#ifdef __cplusplus
}
#endif
```

## src/trle_.h
```c
/**
    Copyright (C) powturbo 2015-2023
    SPDX-License-Identifier: GPL v2 License

    This program is free software; you can redistribute it and/or modify
    it under the terms of the GNU General Public License as published by
    the Free Software Foundation; either version 2 of the License, or
    (at your option) any later version.

    This program is distributed in the hope that it will be useful,
    but WITHOUT ANY WARRANTY; without even the implied warranty of
    MERCHANTABILITY or FITNESS FOR A PARTICULAR PURPOSE.  See the
    GNU General Public License for more details.

    You should have received a copy of the GNU General Public License along
    with this program; if not, write to the Free Software Foundation, Inc.,
    51 Franklin Street, Fifth Floor, Boston, MA 02110-1301 USA.

    - email    : powturbo [AT] gmail.com
    - github   : https://github.com/powturbo
    - homepage : https://sites.google.com/site/powturbo/
    - twitter  : https://twitter.com/powturbo

    TurboRLE - "Most efficient and fastest Run Length Encoding"
**/
//------------------------- Variable Byte ( see https://github.com/powturbo/TurboPFor )-----------------------------------------------------
#include "conf.h"
#define TMIN 3

#define VL_SIZE 32
#define VL_MAX 0xff
#define VL_B2 4
#define VL_B3 3
#define VL_BA3 (VL_MAX - (VL_SIZE/8 - 3))
#define VL_BA2 (VL_BA3 - (1<<VL_B3))

#define VL_OFS1 (VL_BA2 - (1<<VL_B2))
#define VL_OFS2 (VL_OFS1 + (1 << ( 8+VL_B2)))
#define VL_OFS3 (VL_OFS2 + (1 << (16+VL_B3)))

#define _vlput32(_op_, _x_, _act_) {\
  if(likely((_x_) < VL_OFS1)){ *_op_++ = (_x_);                                                                  _act_;}\
  else if  ((_x_) < VL_OFS2) { ctou16(_op_) = bswap16((VL_OFS1<<8)+((_x_)-VL_OFS1));             _op_  += 2;     _act_;}\
  else if  ((_x_) < VL_OFS3) { *_op_++ = VL_BA2 + (((_x_) -= VL_OFS2) >> 16); ctou16(_op_) = (_x_); _op_  += 2;  _act_;}\
  else { unsigned _b = (bsr32((_x_))+7)/8; *_op_++ = VL_BA3 + (_b - 3); ctou32(_op_) = (_x_); _op_  += _b; _act_;}\
}

#define _vlget32(_ip_, _x_, _act_) do { _x_ = *_ip_++;\
       if(likely(_x_ < VL_OFS1)) { _act_ ;}\
  else if(likely(_x_ < VL_BA2))  { _x_ = ((_x_<<8) + (*_ip_)) + (VL_OFS1 - (VL_OFS1 <<  8)); _ip_++; _act_;} \
  else if(likely(_x_ < VL_BA3))  { _x_ = ctou16(_ip_) + ((_x_ - VL_BA2 ) << 16) + VL_OFS2; _ip_ += 2; _act_;}\
  else { unsigned _b = _x_-VL_BA3; _x_ = ctou32(_ip_) & ((1u << 8 * _b << 24) - 1); _ip_ += 3 + _b; _act_;}\
} while(0)

#define vlput32(_op_, _x_) { register unsigned  _x = _x_; _vlput32(_op_, _x, ;); }
#define vlget32(_ip_, _x_) _vlget32(_ip_, _x_, ;)

#define vlzput(_op_, _x_, _m_, _rmap_) do { if(unlikely((_x_) < _m_)) *_op_++ = _rmap_[_x_]; else { unsigned _xi = (_x_) - _m_; *_op_++ = _rmap_[_m_]; vlput32(_op_, _xi); } } while(0)
#define vlzget(_ip_, _x_, _m_, _e_) { _x_ = _e_; if(unlikely(_x_ == _m_)) { vlget32(_ip_,_x_ ); _x_+=_m_; } }
```

## src/trlec.c
```c
/**
    Copyright (C) powturbo 2015-2023
    SPDX-License-Identifier: GPL v2 License

    This program is free software; you can redistribute it and/or modify
    it under the terms of the GNU General Public License as published by
    the Free Software Foundation; either version 2 of the License, or
    (at your option) any later version.

    This program is distributed in the hope that it will be useful,
    but WITHOUT ANY WARRANTY; without even the implied warranty of
    MERCHANTABILITY or FITNESS FOR A PARTICULAR PURPOSE.  See the
    GNU General Public License for more details.

    You should have received a copy of the GNU General Public License along
    with this program; if not, write to the Free Software Foundation, Inc.,
    51 Franklin Street, Fifth Floor, Boston, MA 02110-1301 USA.

    - email    : powturbo [AT] gmail.com
    - github   : https://github.com/powturbo
    - homepage : https://sites.google.com/site/powturbo/
    - twitter  : https://twitter.com/powturbo

    TurboRLE - "Most efficient and fastest Run Length Encoding"
**/
  #ifndef USIZE
#include <string.h>
#include "conf.h"
#include "trle.h"
#include "trle_.h"

  #ifdef __ARM_NEON
#define PREFETCH(_ip_,_rw_)
  #else
#define PREFETCH(_ip_,_rw_) __builtin_prefetch(_ip_,_rw_)
  #endif

//------------------------------------- Fastet Histogram : https://github.com/powturbo/TurboHist -------------------------------------------
#define cnt_t unsigned
#define CSIZE (256 + 8)

#define CU32(u,_i_) {\
  c[_i_+0][(unsigned char) u     ]++;\
  c[_i_+1][(unsigned char)(u>> 8)]++;\
  c[_i_+2][(unsigned char)(u>>16)]++;\
  c[_i_+3][                u>>24 ]++;\
}

#define OV 8
#define INC4_32(_i_) { { unsigned u = ux, v = vx; ux = ctou32(ip+_i_+OV+0); vx = ctou32(ip+_i_+OV+ 4); CU32(u,0); CU32(v,0); }\
                       { unsigned u = ux, v = vx; ux = ctou32(ip+_i_+OV+8); vx = ctou32(ip+_i_+OV+12); CU32(u,0); CU32(v,0); }\
}

static unsigned cntcalc32(const unsigned char *__restrict in, unsigned inlen, cnt_t *__restrict cnt) {
  cnt_t c[4][CSIZE] = {0},i;

  unsigned char *ip = in;
  if(inlen >= 64) {
    unsigned ux = ctou32(ip), vx = ctou32(ip+4);
    for(; ip != in+(inlen&~(64-1))-64; ip += 64) { INC4_32(0); INC4_32(16); INC4_32(32); INC4_32(48); __builtin_prefetch(ip+512, 0); }
  }
  while(ip != in+inlen)
    c[0][*ip++]++;

  for(i = 0; i < 256; i++)
    cnt[i] = c[0][i]+c[1][i]+c[2][i]+c[3][i];
  unsigned a = 256; while(a > 1 && !cnt[a-1]) a--;
  return a;
}

//------------------------------ speed optimized RLE 8 with escape char. SSE/AVX2 slower than scalar in encoding ----------------------------------------
#define SRLE8   (__WORDSIZE/2)

#define USIZE 8
#include "trlec.c"

  #if SRLE8
#define PUTC(_op_, _x_) *_op_++ = _x_
#define PUTE(_op_, _e_) do { PUTC(_op_, _e_); vlput32(_op_, 0); } while(0)

#define SZ64 if((z = (ctou64(ip) ^ ctou64(ip+1)))) goto a; ip += 8;
#define SZ32 if((z = (ctou32(ip) ^ ctou32(ip+1)))) goto a; ip += 4;

#define SRLEPUT8(_pp_, _ip_, _e_, _op_) do {\
  unsigned _r = (_ip_ - _pp_)+1;\
  if(_r >= 4)  { PUTC(_op_, _e_); _r = (_r-4)+3; vlput32(_op_, _r); PUTC(_op_, pp[0]); }\
  else if(pp[0] == _e_) {\
                 PUTC(_op_, _e_); _r -= 1;       vlput32(_op_, _r);  /*1-3:Escape char -> 2-6 bytes */\
  } else while(_r--) PUTC(_op_, pp[0]);\
} while(0)

unsigned _srlec8(const unsigned char *__restrict in, unsigned inlen, unsigned char *__restrict out, uint8_t e) {
  uint8_t *ip = in, *pp = in, *ie = in+inlen, *op = out;

  if(inlen > SRLE8+1)
    while(ip < ie-1-SRLE8) {
        #if __WORDSIZE == 64
      uint64_t z; SZ64; SZ64; SZ64; SZ64;                       __builtin_prefetch(ip +256, 0);
      continue;
      a: ip += ctz64(z)>>3;
        #else
      uint32_t z; SZ32; SZ32; SZ32; SZ32;                       __builtin_prefetch(ip +256, 0);
      continue;
      a: ip += ctz32(z)>>3;
        #endif
      SRLEPUT8(pp, ip, e, op);
      pp = ++ip;
    }

  while(ip < ie-1) {
    while(ip < ie-1 && ip[1] == *pp) ip++;
    SRLEPUT8(pp, ip, e, op);
    pp = ++ip;
  }
  if(ip < ie) {
    unsigned c = *ip++;
    if(c == e) PUTE(op,e);
    else PUTC(op, c);
  }                                                             //AS(ip == ie,"FatalI ip!=ie=%d ", ip-ie)
  return op - out;
}


unsigned _srled8(const unsigned char * __restrict in, unsigned char * __restrict out, unsigned outlen, uint8_t e)
{
return 0;
}#define SRLEPUT8X(_pp_, _ip_, _e_, _op_) do {\
  unsigned _r = (_ip_ - _pp_)+1, _cr = pp[0];\
  if(_r >= 4 /*|| _r == 3 && _cr == ix*/) { PUTC(_op_, _e_); _r = ((_r-4)+3)<<1; if(_cr == ix) { vlput32(_op_, _r); } else { vlput32(_op_, _r|1); PUTC(_op_, pp[0]); } }\
  else if(_cr == _e_) { PUTC(_op_, _e_); _r = (_r-1)<<1|1; vlput32(_op_, _r);  /*1-3:Escape char -> 2-6 bytes */ } \
  else while(_r--) PUTC(_op_, _cr);\
} while(0)

static inline unsigned _srlec8x(const unsigned char *__restrict in, unsigned inlen, unsigned char *__restrict out, uint8_t e, uint8_t ix) {
  uint8_t *ip = in, *pp = in, *ie = in+inlen, *op = out;

  if(inlen > SRLE8+1)
    while(ip < ie-1-SRLE8) {
        #if __WORDSIZE == 64
      uint64_t z; SZ64; SZ64; SZ64; SZ64;                       __builtin_prefetch(ip +256, 0);
      continue;
      a: ip += ctz64(z)>>3;
        #else
      uint32_t z; SZ32; SZ32; SZ32; SZ32;                       __builtin_prefetch(ip +256, 0);
      continue;
      a: ip += ctz32(z)>>3;
        #endif
      SRLEPUT8X(pp, ip, e, op);
      pp = ++ip;
    }

  while(ip < ie-1) {
    while(ip < ie-1 && ip[1] == *pp) ip++;
    SRLEPUT8X(pp, ip, e, op);
    pp = ++ip;
  }
  if(ip < ie) {
    unsigned c = *ip++;
    if(c == e) PUTE(op,e);
    else PUTC(op, c);
  }                                                             //AS(ip == ie,"FatalI ip!=ie=%d ", ip-ie)
  return op - out;
}
  #endif

unsigned srlec(const unsigned char *__restrict in, unsigned inlen, unsigned char *__restrict out) { // Automatic escape char determination
  unsigned cnt[256] = {0}, a, m = -1, x = 0, im = 0, i, ix, l;
  if(!inlen) return 0;

  a = cntcalc32(in, inlen, cnt);
  if(cnt[a-1] == inlen) {
    *out = *in;
    return 1;                                                   // RETURN 1 = memset
  }

  if(a != 256) {                                                // determine escape char
    for(im = a, i = m = 0; i < a; i++)
      if(cnt[i] > x) x = cnt[i],ix = i;
  } else for(i = 0; i < a; i++) {
    if(cnt[i] < m) m = cnt[i],im = i;                           // minimum for ESC char
    if(cnt[i] > x) x = cnt[i],ix = i;                           // maximum for embeding in the run length
  }
  out[0] = im;
  out[1] = ix;
  if((l = _srlec8x(in, inlen, out+2, im, ix)+2) < inlen)
    return l;
  memcpy(out, in, inlen);
  return inlen;
}

//------------------------------------------------- TurboRLE ------------------------------------------
#define TRLEPUT(pp, ip, m, rmap, op) do {\
  int _r_ = (ip - pp)+1;\
  if(_r_ >= TMIN) { \
    unsigned char *q = op; /*checkpoint*/\
    if(pp[0] == ix) { unsigned _r = (_r_ - TMIN)<<1|1; vlzput(op, _r, m, rmap); } else { unsigned _r = (_r_ - TMIN)<<1; vlzput(op, _r, m, rmap); *op++ = pp[0]; }\
    if(op-q >= _r_) { op = q; while(_r_--) *op++ = pp[0]; }  /*rollback rle*/\
  } else while(_r_--) *op++ = pp[0];\
} while(0)

unsigned trlec(const unsigned char *__restrict in, unsigned inlen, unsigned char *__restrict out) {
  unsigned      cnt[256] = {0}, m=-1, x=0, im, i, a, c;
  unsigned char rmap[256], *op=out, *ie = in+inlen, *ip = in,*pp = in, ix;
  if(!inlen) return 0;                                          // RETURN 0 = zero length

  a = cntcalc32(in, inlen, cnt);
  if(cnt[a-1] == inlen) {
    *out = *in;
    return 1;                                                   // RETURN 1 = memset
  }

  if(a != 256) {                                                // determine escape char
    for(im = a, i = m = 0; i < a; i++)
      if(cnt[i] > x) x = cnt[i],ix = i;
  } else for(i = 0; i < a; i++) {
    if(cnt[i] < m) m = cnt[i],im = i;                           // minimum for ESC char
    if(cnt[i] > x) x = cnt[i],ix = i;                           // maximum for embeding in the run length
  }
  if(m) {                                                       // no unused bytes found
    PUTC(op, 0);                                                // 0: srle mode
    PUTC(op, im);                                               // _srlec8 escape char
    op += _srlec8(in, inlen, op, im);
    if(op - out < inlen) return op - out;                       // RETURN rle/escape
    memcpy(out, in, inlen);                                     // no compression, use memcpy
    return inlen;                                               // RETURN outlen = inlen (memcpy)
  }

  c = (a+7)/8;
  PUTC(op, c);                                                  // c = bitmap length in bytes
  memset(op, 0, 32);
  for(m = i = 0; i != c*8; i++)                                 // set bitmap for unused chars
    if(!cnt[i]) op[i>>3] |= 1<<(i&7), rmap[m++] = i;
  op += c;
  for(; i != 256; i++) rmap[m++] = i;

  m--;
  PUTC(op, ix);

  if(inlen > SRLE8+1)                                           // encode
    while(ip < ie-1-SRLE8) {
        #if __WORDSIZE == 64
      uint64_t z; SZ64; SZ64; SZ64; SZ64;                       __builtin_prefetch(ip +256, 0);
      continue;
      a: ip += ctz64(z)>>3;
        #else
      uint32_t z; SZ32; SZ32; SZ32; SZ32;                       __builtin_prefetch(ip +256, 0);
      continue;
      a: ip += ctz32(z)>>3;
        #endif
      TRLEPUT(pp, ip, m, rmap, op);
      pp = ++ip;
    }

  while(ip < ie-1) {
    while(ip < ie-1 && ip[1] == *pp) ip++;
    TRLEPUT(pp, ip, m, rmap, op);
    pp = ++ip;
  }
  if(ip < ie) PUTC(op, *ip++);                                      
                                                                AS(ip == ie, "Fatal ip>ie=%d ", (int)(ip-ie));

  if(op - out < inlen)
    return op - out;                                            // RETURN length = rle
  memcpy(out, in, inlen);                                       // no compression, use memcpy
  return inlen;                                                 // RETURN outlen = inlen (memcpy)
}

#if 0
unsigned trlelen(const unsigned char *__restrict in, unsigned inlen) {
  unsigned      cnt[256] = {0}, m=-1, x=0, im, i, a, c;
  unsigned char rmap[256], *ie = in+inlen, *ip = in,*pp = in, ix;
  if(!inlen) return 0;                                          // RETURN 0 = zero length

  a = cntcalc32(in, inlen, cnt);
  if(cnt[a-1] == inlen) {
    *out = *in;
    return 1;                                                   // RETURN 1 = memset
  }

  if(a != 256) {                                                // determine escape char
    for(im = a, i = m = 0; i < a; i++)
      if(cnt[i] > x) x = cnt[i],ix = i;
  } else for(i = 0; i < a; i++) {
    if(cnt[i] < m) m = cnt[i],im = i;                           // minimum for ESC char
    if(cnt[i] > x) x = cnt[i],ix = i;                           // maximum for embeding in the run length
  }
  if(m) {                                                       // no unused bytes found
    rlelen++;                                                // 0: srle mode
    rlelen++;                                               // _srlec8 escape char
    rlelen += _srlelen8(in, inlen, op, im);
    if(rlelen < inlen) return rlelen;                       // RETURN rle/escape
    return inlen;                                               // RETURN outlen = inlen (memcpy)
  }

  c = (a+7)/8;
  rlelen++; //PUTC(op, c);                                                  // c = bitmap length in bytes
  //memset(op, 0, 32);
  for(m = i = 0; i != c*8; i++)                                 // set bitmap for unused chars
    if(!cnt[i]) op[i>>3] |= 1<<(i&7), rmap[m++] = i;
  rlelen += c; //op += c;
  for(; i != 256; i++) rmap[m++] = i;

  m--;
  rlelen++; //PUTC(op, ix);

  if(inlen > SRLE8+1)                                           // encode
    while(ip < ie-1-SRLE8) {
        #if __WORDSIZE == 64
      uint64_t z; SZ64; SZ64; SZ64; SZ64;                       __builtin_prefetch(ip +256, 0);
      continue;
      a: ip += ctz64(z)>>3;
        #else
      uint32_t z; SZ32; SZ32; SZ32; SZ32;                       __builtin_prefetch(ip +256, 0);
      continue;
      a: ip += ctz32(z)>>3;
        #endif
      TRLEPUT(pp, ip, m, rmap, op);
      pp = ++ip;
    }

  while(ip < ie-1) {
    while(ip < ie-1 && ip[1] == *pp) ip++;
    TRLEPUT(pp, ip, m, rmap, op);
    pp = ++ip;
  }
  if(ip < ie) PUTC(op, *ip++);                                      AS(ip == ie, "Fatal ip>ie=%d ", (int)(ip-ie));

  if(op - out < inlen)
    return op - out;                                            // RETURN length = rle
  memcpy(out, in, inlen);                                       // no compression, use memcpy
  return inlen;                                                 // RETURN outlen = inlen (memcpy)
}
#endif

#undef USIZE
#undef SRLE8
//------------------------------------- RLE 16, 32, 64 --------------------------------------------------
#define USIZE 16
#include "trlec.c"
#undef USIZE

#define USIZE 32
#include "trlec.c"
#undef USIZE

#define USIZE 64
#include "trlec.c"
#include "trle.h"
#undef USIZE

#else // ------------------- include RLE 16, 32, 64
#define uint_t T3(uint, USIZE, _t)
#define ctout(_x_) *(uint_t *)(_x_)

#define PUTC(_op_, _x_) ctout(_op_) = _x_, _op_ += sizeof(uint_t)
#define PUTE(_op_, _e_) do { PUTC(_op_, _e_); vlput32(_op_, 0); } while(0)

#define SRLEPUT(_pp_, _ip_, _e_, _op_) do {\
  unsigned _r = (_ip_ - _pp_)+1;\
  if(_r >= 4)  { PUTC(_op_, _e_); _r = (_r-4)+3; vlput32(_op_, _r); PUTC(_op_, pp[0]); }\
  else if(pp[0] == _e_) {\
                 PUTC(_op_, _e_); _r -= 1;       vlput32(_op_, _r);\
  } else while(_r--) PUTC(_op_, pp[0]);\
} while(0)

  #if !SRLE8
unsigned T2(_srlec, USIZE)(const unsigned char *__restrict cin, unsigned inlen, unsigned char *__restrict out, uint_t e) {
  unsigned  char *op = out;
  unsigned  n = inlen/sizeof(uint_t);
  uint_t   *in = (uint_t *)cin, *pp = in, *ip = in, *ie = in+n;

  if(!inlen) return 0;
  #define SZ1 if(ip[0] != ip[1]) goto a; ++ip;
  if(n > 6+1)
    while(ip < ie-1-6) {                                        // fast encode
      SZ1; SZ1; SZ1; SZ1; SZ1; SZ1;                             __builtin_prefetch(ip +128*USIZE/8, 0);
      continue;
      a:
      SRLEPUT(pp, ip, e, op);
      pp = ++ip;
    }

  while(ip < ie - 1) {                                          // encode rest
    while(ip < ie-1 && ip[1] == *pp) ip++;
    SRLEPUT(pp, ip, e, op);
    pp = ++ip;
  }
  if(ip < ie) {                                                 // last item
    uint_t c = *ip++;
    if(c == e) PUTE(op, e);
    else PUTC(op, c);
  }                                                             //AS(ip == ie,"FatalI ip!=ie=%d ", ip-ie)
    #if USIZE > 8
  { unsigned char *p = (unsigned char *)ip;                     // remaining bytes inlen % USIZE/8
    while(p < cin+inlen)
      *op++ = *p++;
  }
    #endif
                                                                //AS(ip == ie,"FatalI ip!=ie=%d ", ip-ie)
  return op - out;
}
 #endif
#undef SRLEPUT
#undef PUTC
#undef PUTE

unsigned T2(srlec, USIZE)(const unsigned char *__restrict in, unsigned inlen, unsigned char *__restrict out, uint_t e) {
  unsigned l = T2(_srlec, USIZE)(in, inlen, out, e);

  if(l < inlen)
    return l;
  memcpy(out, in, inlen);
  return inlen;
}
#endif
```
